## firmware/main/Kconfig.projbuild
```kconfig
menu "RC capture validation"
config BRIDGE_RC03_DIAGNOSTIC_STRESS
    bool "Pad diagnostic records to 384 bytes (isolated bench only)"
    default n
config BRIDGE_RC03_ACCURACY_TRACE
    bool "Collect a bounded 128-record accuracy archive (isolated bench only)"
    default n
endmenu

menu "Isolated no-pump waveform validation"
config BRIDGE_PUMP04_BENCH
    bool "Finite waveform test after every app boot (NO PUMP)"
    default n
config BRIDGE_PUMP04_SCENARIO
    int "1=waveform, 2=stress, 3=accuracy"
    range 1 3
    default 1
    depends on BRIDGE_PUMP04_BENCH
config BRIDGE_PUMP04_TRACE_STEP
    int "Accuracy collector step (explicit build-wrapper argument required)"
    range -1 5
    default -1
    depends on BRIDGE_PUMP04_BENCH && BRIDGE_PUMP04_SCENARIO = 3
endmenu
```

## firmware/sdkconfig.defaults
```kconfig
CONFIG_IDF_TARGET="esp32c3"
CONFIG_ESPTOOLPY_FLASHMODE_DIO=y
CONFIG_ESPTOOLPY_FLASHFREQ_40M=y
CONFIG_ESPTOOLPY_FLASHSIZE_4MB=y
CONFIG_PARTITION_TABLE_SINGLE_APP=y
CONFIG_BOOTLOADER_LOG_LEVEL_NONE=y
CONFIG_LOG_DEFAULT_LEVEL_NONE=y
CONFIG_LOG_MAXIMUM_EQUALS_DEFAULT=y
CONFIG_FREERTOS_HZ=100
CONFIG_ESP_CONSOLE_USB_SERIAL_JTAG=y
CONFIG_ESP_CONSOLE_SECONDARY_NONE=y
CONFIG_RMT_RX_ISR_CACHE_SAFE=y
CONFIG_RMT_RECV_FUNC_IN_IRAM=y
CONFIG_GPIO_CTRL_FUNC_IN_IRAM=y
CONFIG_PM_ENABLE=n
CONFIG_FREERTOS_USE_TICKLESS_IDLE=n
```
